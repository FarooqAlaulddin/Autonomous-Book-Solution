
// Stepper motor pins
#define steppinVertical 7 //driver 1
#define dirpinVertical 8

#define steppinHorizontal 3 //driver 2
#define dirpinHorizontal 4

//#define button4 13
//#define button3 12
//#define button2 11
//#define button1 10

int buttonPressed;

void setup() {
  
  Serial.begin(9600);
  
  pinMode(steppinVertical, OUTPUT);
  pinMode(dirpinVertical, OUTPUT);
  pinMode(steppinHorizontal, OUTPUT);
  pinMode(dirpinHorizontal, OUTPUT);
  
//  pinMode(steppinVertical_2, OUTPUT);
//  pinMode(dirpinVertical_2, OUTPUT);
    
//  pinMode(button1, INPUT_PULLUP);
//  pinMode(button2, INPUT_PULLUP);
//  pinMode(button3, INPUT_PULLUP);
//  pinMode(button4, INPUT_PULLUP);
  
}

void loop() 
{
  Serial.println("Ardunio Steppers Started");
  delay(1000);

  if(Serial.available() > 0){
    buttonPressed = Serial.read();
    Serial.print("Ardunio Received ");
    Serial.print(buttonPressed, DEC);
    Serial.println();
  }
  
  // while (true)
  // {
  //   if (digitalRead(button1) == LOW) 
  //   {
  //   buttonPressed = 1;
  //   break;
  //   }
    
  //   if (digitalRead(button2) == LOW) 
  //   {
  //   buttonPressed = 2;
  //   break;
  //   }

  //   if (digitalRead(button3) == LOW) 
  //   {
  //   buttonPressed = 3;
  //   break;
  //   }

  //   if (digitalRead(button4) == LOW) 
  //   {
  //   buttonPressed = 4;
  //   break;
  //   }
  // }
  


  switch (buttonPressed) {
    case 49: // 1 in ascii
    moveUp(1000 * 14.5); //this number indicates the rotations it does
  //  moveUp_2(1000 * 14.5);
    delay(200); 
    break;
    
    case 50: // 2 ascii
    moveDown(1000 * 14.5); //this number indicates the rotations it does
  //  moveDown_2(1000 * 14.5);
    delay(200); 
    break;
    
    case 51: // 3 ascii
    moveLeft(1000 * 13.3); //this number indicates the rotations it does
    delay(10); 
    break;
    
    case 52: // 4 ascii
    moveRight(1000 * 13.3); //this number indicates the rotations it does
    delay(10); 
    break;
    
    case 53: // 5 ascii 
    moveUp(1000 * 3.3);    //Half up for default position
    delay(160);
    break;
    
    case 54: // 6 ascii
    moveDown(1000 * 3.3);  //Half down for default position
    delay(160);
    break;
    
    
  }
  
  buttonPressed=0;

}

//SLIDER FUNCTIONS 
void moveRight (int steps) {
  digitalWrite(dirpinHorizontal, LOW); //high is CC from top view(LEFT), Low is CCW (RIGHT)
  for (int x = 0; x < steps; x++) {
    digitalWrite(steppinHorizontal, LOW);
    delayMicroseconds(90); //how fast it will spin, the lower the number the faster
    digitalWrite(steppinHorizontal, HIGH);
    delayMicroseconds(90);
  }
}
void moveLeft (int steps) {
  digitalWrite(dirpinHorizontal, HIGH);
  for (int x = 0; x < steps; x++) {
    digitalWrite(steppinHorizontal, LOW);
    delayMicroseconds(90);
    digitalWrite(steppinHorizontal, HIGH);
    delayMicroseconds(90);
  }
}

void moveUp (int steps) {
  digitalWrite(dirpinVertical, LOW); //high is CC from top view (DOWNWARDS), Low is CCW (UPWARDS)
  for (int x = 0; x < steps; x++) {
    digitalWrite(steppinVertical, HIGH);
    delayMicroseconds(120);
    digitalWrite(steppinVertical, LOW);
    delayMicroseconds(120);
  }
}

void moveDown (int steps) {
  digitalWrite(dirpinVertical, HIGH);
  for (int x = 0; x < steps; x++) {
    digitalWrite(steppinVertical, HIGH);
    delayMicroseconds(120);
    digitalWrite(steppinVertical, LOW);
    delayMicroseconds(120);
  }
}